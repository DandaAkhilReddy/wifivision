## firmware/sdkconfig.defaults
```kconfig
# WiFiVision ESP32 Firmware Configuration Defaults
# Copy to esp-csi/examples/get-started/csi_recv_router/sdkconfig.defaults
# Or apply manually in menuconfig

# ========================================
# WiFi CSI Configuration (REQUIRED)
# ========================================
CONFIG_ESP_WIFI_CSI_ENABLED=y

# ========================================
# FreeRTOS Configuration
# ========================================
# Higher tick rate for better timing resolution
CONFIG_FREERTOS_HZ=1000

# ========================================
# Serial/UART Configuration
# ========================================
# High baud rate for fast CSI data streaming
CONFIG_ESP_CONSOLE_UART_BAUDRATE=921600

# ========================================
# CPU Configuration
# ========================================
# Maximum CPU frequency for best performance
CONFIG_ESP_DEFAULT_CPU_FREQ_MHZ_240=y
CONFIG_ESP_DEFAULT_CPU_FREQ_MHZ=240

# ========================================
# WiFi Configuration
# ========================================
# Disable AMPDU for more consistent CSI
CONFIG_ESP_WIFI_AMPDU_TX_ENABLED=n
CONFIG_ESP_WIFI_AMPDU_RX_ENABLED=n

# Dynamic buffer settings
CONFIG_ESP_WIFI_DYNAMIC_RX_BUFFER_NUM=128
CONFIG_ESP_WIFI_DYNAMIC_TX_BUFFER_NUM=32

# ========================================
# Example-specific Configuration
# ========================================
# Set your WiFi credentials in menuconfig:
# CONFIG_EXAMPLE_WIFI_SSID="YourSSID"
# CONFIG_EXAMPLE_WIFI_PASSWORD="YourPassword"

# ========================================
# Optional: Logging
# ========================================
# Reduce log verbosity for cleaner CSI output
# CONFIG_LOG_DEFAULT_LEVEL_WARN=y
```
